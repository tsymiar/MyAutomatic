/* soapH.h
   Generated by gSOAP 2.8.106 for rpcapi.h

gSOAP XML Web services tools
Copyright (C) 2000-2020, Robert van Engelen, Genivia Inc. All Rights Reserved.
The soapcpp2 tool and its generated software are released under the GPL.
This program is released under the GPL with the additional exemption that
compiling, linking, and/or using OpenSSL is allowed.
--------------------------------------------------------------------------------
A commercial use license is available from Genivia Inc., contact@genivia.com
--------------------------------------------------------------------------------
*/

#ifndef soapH_H
#define soapH_H
#include "soapStub.h"
#ifndef WITH_NOIDREF

#ifdef __cplusplus
extern "C" {
#endif
SOAP_FMAC3 void SOAP_FMAC4 soap_markelement(struct soap*, const void*, int);

#ifdef __cplusplus
}
#endif
SOAP_FMAC3 int SOAP_FMAC4 soap_putindependent(struct soap*);
SOAP_FMAC3 int SOAP_FMAC4 soap_getindependent(struct soap*);
#endif

#ifdef __cplusplus
extern "C" {
#endif
SOAP_FMAC3 void * SOAP_FMAC4 soap_getelement(struct soap*, const char*, int*);
SOAP_FMAC3 int SOAP_FMAC4 soap_putelement(struct soap*, const void*, const char*, int, int);
SOAP_FMAC3 void * SOAP_FMAC4 soap_dupelement(struct soap*, const void*, int);
SOAP_FMAC3 void SOAP_FMAC4 soap_delelement(const void*, int);

#ifdef __cplusplus
}
#endif
SOAP_FMAC3 int SOAP_FMAC4 soap_ignore_element(struct soap*);
SOAP_FMAC3 void * SOAP_FMAC4 soap_instantiate(struct soap*, int, const char*, const char*, size_t*);
SOAP_FMAC3 int SOAP_FMAC4 soap_fdelete(struct soap *soap, struct soap_clist*);
SOAP_FMAC3 int SOAP_FMAC4 soap_fbase(int, int);
SOAP_FMAC3 void SOAP_FMAC4 soap_finsert(struct soap*, int, int, void*, size_t, const void*, void**);

#ifndef SOAP_TYPE_byte_DEFINED
#define SOAP_TYPE_byte_DEFINED

inline void soap_default_byte(struct soap *soap, char *a)
{
	(void)soap; /* appease -Wall -Werror */
#ifdef SOAP_DEFAULT_byte
	*a = SOAP_DEFAULT_byte;
#else
	*a = (char)0;
#endif
}
SOAP_FMAC3 int SOAP_FMAC4 soap_out_byte(struct soap*, const char*, int, const char *, const char*);
SOAP_FMAC3 char * SOAP_FMAC4 soap_in_byte(struct soap*, const char*, char *, const char*);

SOAP_FMAC3 char * SOAP_FMAC4 soap_new_byte(struct soap *soap, int n = -1);
SOAP_FMAC3 int SOAP_FMAC4 soap_put_byte(struct soap*, const char *, const char*, const char*);

inline int soap_write_byte(struct soap *soap, char const*p)
{
	soap_free_temp(soap);
	if (p)
	{	if (soap_begin_send(soap) || ::soap_put_byte(soap, p, "byte", "") || soap_end_send(soap))
			return soap->error;
	}
	return SOAP_OK;
}

inline int soap_PUT_byte(struct soap *soap, const char *URL, char const*p)
{
	soap_free_temp(soap);
	if (soap_PUT(soap, URL, NULL, "text/xml; charset=utf-8") || ::soap_put_byte(soap, p, "byte", "") || soap_end_send(soap) || soap_recv_empty_response(soap))
		return soap_closesock(soap);
	return SOAP_OK;
}

inline int soap_PATCH_byte(struct soap *soap, const char *URL, char const*p)
{
	soap_free_temp(soap);
	if (soap_PATCH(soap, URL, NULL, "text/xml; charset=utf-8") || ::soap_put_byte(soap, p, "byte", "") || soap_end_send(soap) || soap_recv_empty_response(soap))
		return soap_closesock(soap);
	return SOAP_OK;
}

inline int soap_POST_send_byte(struct soap *soap, const char *URL, char const*p)
{
	soap_free_temp(soap);
	if (soap_POST(soap, URL, NULL, "text/xml; charset=utf-8") || ::soap_put_byte(soap, p, "byte", "") || soap_end_send(soap))
		return soap_closesock(soap);
	return SOAP_OK;
}
SOAP_FMAC3 char * SOAP_FMAC4 soap_get_byte(struct soap*, char *, const char*, const char*);

inline int soap_read_byte(struct soap *soap, char *p)
{
	if (p)
	{	if (soap_begin_recv(soap) || ::soap_get_byte(soap, p, NULL, NULL) == NULL || soap_end_recv(soap))
			return soap->error;
	}
	return SOAP_OK;
}

inline int soap_GET_byte(struct soap *soap, const char *URL, char *p)
{
	if (soap_GET(soap, URL, NULL) || ::soap_read_byte(soap, p))
		return soap_closesock(soap);
	return soap_closesock(soap);
}

inline int soap_POST_recv_byte(struct soap *soap, char *p)
{
	if (::soap_read_byte(soap, p))
		return soap_closesock(soap);
	return soap_closesock(soap);
}
#endif

#ifndef SOAP_TYPE_int_DEFINED
#define SOAP_TYPE_int_DEFINED

inline void soap_default_int(struct soap *soap, int *a)
{
	(void)soap; /* appease -Wall -Werror */
#ifdef SOAP_DEFAULT_int
	*a = SOAP_DEFAULT_int;
#else
	*a = (int)0;
#endif
}
SOAP_FMAC3 int SOAP_FMAC4 soap_out_int(struct soap*, const char*, int, const int *, const char*);
SOAP_FMAC3 int * SOAP_FMAC4 soap_in_int(struct soap*, const char*, int *, const char*);

SOAP_FMAC3 int * SOAP_FMAC4 soap_new_int(struct soap *soap, int n = -1);
SOAP_FMAC3 int SOAP_FMAC4 soap_put_int(struct soap*, const int *, const char*, const char*);

inline int soap_write_int(struct soap *soap, int const*p)
{
	soap_free_temp(soap);
	if (p)
	{	if (soap_begin_send(soap) || ::soap_put_int(soap, p, "int", "") || soap_end_send(soap))
			return soap->error;
	}
	return SOAP_OK;
}

inline int soap_PUT_int(struct soap *soap, const char *URL, int const*p)
{
	soap_free_temp(soap);
	if (soap_PUT(soap, URL, NULL, "text/xml; charset=utf-8") || ::soap_put_int(soap, p, "int", "") || soap_end_send(soap) || soap_recv_empty_response(soap))
		return soap_closesock(soap);
	return SOAP_OK;
}

inline int soap_PATCH_int(struct soap *soap, const char *URL, int const*p)
{
	soap_free_temp(soap);
	if (soap_PATCH(soap, URL, NULL, "text/xml; charset=utf-8") || ::soap_put_int(soap, p, "int", "") || soap_end_send(soap) || soap_recv_empty_response(soap))
		return soap_closesock(soap);
	return SOAP_OK;
}

inline int soap_POST_send_int(struct soap *soap, const char *URL, int const*p)
{
	soap_free_temp(soap);
	if (soap_POST(soap, URL, NULL, "text/xml; charset=utf-8") || ::soap_put_int(soap, p, "int", "") || soap_end_send(soap))
		return soap_closesock(soap);
	return SOAP_OK;
}
SOAP_FMAC3 int * SOAP_FMAC4 soap_get_int(struct soap*, int *, const char*, const char*);

inline int soap_read_int(struct soap *soap, int *p)
{
	if (p)
	{	if (soap_begin_recv(soap) || ::soap_get_int(soap, p, NULL, NULL) == NULL || soap_end_recv(soap))
			return soap->error;
	}
	return SOAP_OK;
}

inline int soap_GET_int(struct soap *soap, const char *URL, int *p)
{
	if (soap_GET(soap, URL, NULL) || ::soap_read_int(soap, p))
		return soap_closesock(soap);
	return soap_closesock(soap);
}

inline int soap_POST_recv_int(struct soap *soap, int *p)
{
	if (::soap_read_int(soap, p))
		return soap_closesock(soap);
	return soap_closesock(soap);
}
#endif

#ifndef SOAP_TYPE_xsd_int_DEFINED
#define SOAP_TYPE_xsd_int_DEFINED

inline void soap_default_xsd_int(struct soap *soap, long *a)
{
	(void)soap; /* appease -Wall -Werror */
#ifdef SOAP_DEFAULT_xsd_int
	*a = SOAP_DEFAULT_xsd_int;
#else
	*a = (long)0;
#endif
}

#define soap_xsd_int2s soap_long2s

SOAP_FMAC3 int SOAP_FMAC4 soap_out_xsd_int(struct soap*, const char*, int, const long *, const char*);

#define soap_s2xsd_int soap_s2long

SOAP_FMAC3 long * SOAP_FMAC4 soap_in_xsd_int(struct soap*, const char*, long *, const char*);

#define soap_instantiate_xsd_int soap_instantiate_long


#define soap_new_xsd_int soap_new_long

SOAP_FMAC3 int SOAP_FMAC4 soap_put_xsd_int(struct soap*, const long *, const char*, const char*);

inline int soap_write_xsd_int(struct soap *soap, long const*p)
{
	soap_free_temp(soap);
	if (p)
	{	if (soap_begin_send(soap) || ::soap_put_xsd_int(soap, p, "xsd-int", "") || soap_end_send(soap))
			return soap->error;
	}
	return SOAP_OK;
}

inline int soap_PUT_xsd_int(struct soap *soap, const char *URL, long const*p)
{
	soap_free_temp(soap);
	if (soap_PUT(soap, URL, NULL, "text/xml; charset=utf-8") || ::soap_put_xsd_int(soap, p, "xsd-int", "") || soap_end_send(soap) || soap_recv_empty_response(soap))
		return soap_closesock(soap);
	return SOAP_OK;
}

inline int soap_PATCH_xsd_int(struct soap *soap, const char *URL, long const*p)
{
	soap_free_temp(soap);
	if (soap_PATCH(soap, URL, NULL, "text/xml; charset=utf-8") || ::soap_put_xsd_int(soap, p, "xsd-int", "") || soap_end_send(soap) || soap_recv_empty_response(soap))
		return soap_closesock(soap);
	return SOAP_OK;
}

inline int soap_POST_send_xsd_int(struct soap *soap, const char *URL, long const*p)
{
	soap_free_temp(soap);
	if (soap_POST(soap, URL, NULL, "text/xml; charset=utf-8") || ::soap_put_xsd_int(soap, p, "xsd-int", "") || soap_end_send(soap))
		return soap_closesock(soap);
	return SOAP_OK;
}
SOAP_FMAC3 long * SOAP_FMAC4 soap_get_xsd_int(struct soap*, long *, const char*, const char*);

inline int soap_read_xsd_int(struct soap *soap, long *p)
{
	if (p)
	{	if (soap_begin_recv(soap) || ::soap_get_xsd_int(soap, p, NULL, NULL) == NULL || soap_end_recv(soap))
			return soap->error;
	}
	return SOAP_OK;
}

inline int soap_GET_xsd_int(struct soap *soap, const char *URL, long *p)
{
	if (soap_GET(soap, URL, NULL) || ::soap_read_xsd_int(soap, p))
		return soap_closesock(soap);
	return soap_closesock(soap);
}

inline int soap_POST_recv_xsd_int(struct soap *soap, long *p)
{
	if (::soap_read_xsd_int(soap, p))
		return soap_closesock(soap);
	return soap_closesock(soap);
}
#endif

#ifndef SOAP_TYPE_long_DEFINED
#define SOAP_TYPE_long_DEFINED

inline void soap_default_long(struct soap *soap, long *a)
{
	(void)soap; /* appease -Wall -Werror */
#ifdef SOAP_DEFAULT_long
	*a = SOAP_DEFAULT_long;
#else
	*a = (long)0;
#endif
}
SOAP_FMAC3 int SOAP_FMAC4 soap_out_long(struct soap*, const char*, int, const long *, const char*);
SOAP_FMAC3 long * SOAP_FMAC4 soap_in_long(struct soap*, const char*, long *, const char*);

SOAP_FMAC3 long * SOAP_FMAC4 soap_new_long(struct soap *soap, int n = -1);
SOAP_FMAC3 int SOAP_FMAC4 soap_put_long(struct soap*, const long *, const char*, const char*);

inline int soap_write_long(struct soap *soap, long const*p)
{
	soap_free_temp(soap);
	if (p)
	{	if (soap_begin_send(soap) || ::soap_put_long(soap, p, "long", "") || soap_end_send(soap))
			return soap->error;
	}
	return SOAP_OK;
}

inline int soap_PUT_long(struct soap *soap, const char *URL, long const*p)
{
	soap_free_temp(soap);
	if (soap_PUT(soap, URL, NULL, "text/xml; charset=utf-8") || ::soap_put_long(soap, p, "long", "") || soap_end_send(soap) || soap_recv_empty_response(soap))
		return soap_closesock(soap);
	return SOAP_OK;
}

inline int soap_PATCH_long(struct soap *soap, const char *URL, long const*p)
{
	soap_free_temp(soap);
	if (soap_PATCH(soap, URL, NULL, "text/xml; charset=utf-8") || ::soap_put_long(soap, p, "long", "") || soap_end_send(soap) || soap_recv_empty_response(soap))
		return soap_closesock(soap);
	return SOAP_OK;
}

inline int soap_POST_send_long(struct soap *soap, const char *URL, long const*p)
{
	soap_free_temp(soap);
	if (soap_POST(soap, URL, NULL, "text/xml; charset=utf-8") || ::soap_put_long(soap, p, "long", "") || soap_end_send(soap))
		return soap_closesock(soap);
	return SOAP_OK;
}
SOAP_FMAC3 long * SOAP_FMAC4 soap_get_long(struct soap*, long *, const char*, const char*);

inline int soap_read_long(struct soap *soap, long *p)
{
	if (p)
	{	if (soap_begin_recv(soap) || ::soap_get_long(soap, p, NULL, NULL) == NULL || soap_end_recv(soap))
			return soap->error;
	}
	return SOAP_OK;
}

inline int soap_GET_long(struct soap *soap, const char *URL, long *p)
{
	if (soap_GET(soap, URL, NULL) || ::soap_read_long(soap, p))
		return soap_closesock(soap);
	return soap_closesock(soap);
}

inline int soap_POST_recv_long(struct soap *soap, long *p)
{
	if (::soap_read_long(soap, p))
		return soap_closesock(soap);
	return soap_closesock(soap);
}
#endif

#ifndef WITH_NOGLOBAL

#ifndef SOAP_TYPE_SOAP_ENV__Fault_DEFINED
#define SOAP_TYPE_SOAP_ENV__Fault_DEFINED
SOAP_FMAC3 void SOAP_FMAC4 soap_default_SOAP_ENV__Fault(struct soap*, struct SOAP_ENV__Fault *);
SOAP_FMAC3 void SOAP_FMAC4 soap_serialize_SOAP_ENV__Fault(struct soap*, const struct SOAP_ENV__Fault *);
SOAP_FMAC3 int SOAP_FMAC4 soap_out_SOAP_ENV__Fault(struct soap*, const char*, int, const struct SOAP_ENV__Fault *, const char*);
SOAP_FMAC3 struct SOAP_ENV__Fault * SOAP_FMAC4 soap_in_SOAP_ENV__Fault(struct soap*, const char*, struct SOAP_ENV__Fault *, const char*);
SOAP_FMAC1 struct SOAP_ENV__Fault * SOAP_FMAC2 soap_instantiate_SOAP_ENV__Fault(struct soap*, int, const char*, const char*, size_t*);

inline struct SOAP_ENV__Fault * soap_new_SOAP_ENV__Fault(struct soap *soap, int n = -1)
{
	return soap_instantiate_SOAP_ENV__Fault(soap, n, NULL, NULL, NULL);
}

inline struct SOAP_ENV__Fault * soap_new_req_SOAP_ENV__Fault(
	struct soap *soap)
{
	struct SOAP_ENV__Fault *_p = ::soap_new_SOAP_ENV__Fault(soap);
	if (_p)
	{	::soap_default_SOAP_ENV__Fault(soap, _p);
	}
	return _p;
}

inline struct SOAP_ENV__Fault * soap_new_set_SOAP_ENV__Fault(
	struct soap *soap,
	char *faultcode,
	char *faultstring,
	char *faultactor,
	struct SOAP_ENV__Detail *detail,
	struct SOAP_ENV__Code *SOAP_ENV__Code,
	struct SOAP_ENV__Reason *SOAP_ENV__Reason,
	char *SOAP_ENV__Node,
	char *SOAP_ENV__Role,
	struct SOAP_ENV__Detail *SOAP_ENV__Detail)
{
	struct SOAP_ENV__Fault *_p = ::soap_new_SOAP_ENV__Fault(soap);
	if (_p)
	{	::soap_default_SOAP_ENV__Fault(soap, _p);
		_p->faultcode = faultcode;
		_p->faultstring = faultstring;
		_p->faultactor = faultactor;
		_p->detail = detail;
		_p->SOAP_ENV__Code = SOAP_ENV__Code;
		_p->SOAP_ENV__Reason = SOAP_ENV__Reason;
		_p->SOAP_ENV__Node = SOAP_ENV__Node;
		_p->SOAP_ENV__Role = SOAP_ENV__Role;
		_p->SOAP_ENV__Detail = SOAP_ENV__Detail;
	}
	return _p;
}
SOAP_FMAC3 int SOAP_FMAC4 soap_put_SOAP_ENV__Fault(struct soap*, const struct SOAP_ENV__Fault *, const char*, const char*);

inline int soap_write_SOAP_ENV__Fault(struct soap *soap, struct SOAP_ENV__Fault const*p)
{
	soap_free_temp(soap);
	if (soap_begin_send(soap) || (::soap_serialize_SOAP_ENV__Fault(soap, p), 0) || ::soap_put_SOAP_ENV__Fault(soap, p, "SOAP-ENV:Fault", "") || soap_end_send(soap))
			return soap->error;
	return SOAP_OK;
}

inline int soap_PUT_SOAP_ENV__Fault(struct soap *soap, const char *URL, struct SOAP_ENV__Fault const*p)
{
	soap_free_temp(soap);
	if (soap_PUT(soap, URL, NULL, "text/xml; charset=utf-8") || (::soap_serialize_SOAP_ENV__Fault(soap, p), 0) || ::soap_put_SOAP_ENV__Fault(soap, p, "SOAP-ENV:Fault", "") || soap_end_send(soap) || soap_recv_empty_response(soap))
		return soap_closesock(soap);
	return SOAP_OK;
}

inline int soap_PATCH_SOAP_ENV__Fault(struct soap *soap, const char *URL, struct SOAP_ENV__Fault const*p)
{
	soap_free_temp(soap);
	if (soap_PATCH(soap, URL, NULL, "text/xml; charset=utf-8") || (::soap_serialize_SOAP_ENV__Fault(soap, p), 0) || ::soap_put_SOAP_ENV__Fault(soap, p, "SOAP-ENV:Fault", "") || soap_end_send(soap) || soap_recv_empty_response(soap))
		return soap_closesock(soap);
	return SOAP_OK;
}

inline int soap_POST_send_SOAP_ENV__Fault(struct soap *soap, const char *URL, struct SOAP_ENV__Fault const*p)
{
	soap_free_temp(soap);
	if (soap_POST(soap, URL, NULL, "text/xml; charset=utf-8") || (::soap_serialize_SOAP_ENV__Fault(soap, p), 0) || ::soap_put_SOAP_ENV__Fault(soap, p, "SOAP-ENV:Fault", "") || soap_end_send(soap))
		return soap_closesock(soap);
	return SOAP_OK;
}
SOAP_FMAC3 struct SOAP_ENV__Fault * SOAP_FMAC4 soap_get_SOAP_ENV__Fault(struct soap*, struct SOAP_ENV__Fault *, const char*, const char*);

inline int soap_read_SOAP_ENV__Fault(struct soap *soap, struct SOAP_ENV__Fault *p)
{
	if (p)
	{	::soap_default_SOAP_ENV__Fault(soap, p);
		if (soap_begin_recv(soap) || ::soap_get_SOAP_ENV__Fault(soap, p, NULL, NULL) == NULL || soap_end_recv(soap))
			return soap->error;
	}
	return SOAP_OK;
}

inline int soap_GET_SOAP_ENV__Fault(struct soap *soap, const char *URL, struct SOAP_ENV__Fault *p)
{
	if (soap_GET(soap, URL, NULL) || ::soap_read_SOAP_ENV__Fault(soap, p))
		return soap_closesock(soap);
	return soap_closesock(soap);
}

inline int soap_POST_recv_SOAP_ENV__Fault(struct soap *soap, struct SOAP_ENV__Fault *p)
{
	if (::soap_read_SOAP_ENV__Fault(soap, p))
		return soap_closesock(soap);
	return soap_closesock(soap);
}
#endif

#endif

#ifndef WITH_NOGLOBAL

#ifndef SOAP_TYPE_SOAP_ENV__Reason_DEFINED
#define SOAP_TYPE_SOAP_ENV__Reason_DEFINED
SOAP_FMAC3 void SOAP_FMAC4 soap_default_SOAP_ENV__Reason(struct soap*, struct SOAP_ENV__Reason *);
SOAP_FMAC3 void SOAP_FMAC4 soap_serialize_SOAP_ENV__Reason(struct soap*, const struct SOAP_ENV__Reason *);
SOAP_FMAC3 int SOAP_FMAC4 soap_out_SOAP_ENV__Reason(struct soap*, const char*, int, const struct SOAP_ENV__Reason *, const char*);
SOAP_FMAC3 struct SOAP_ENV__Reason * SOAP_FMAC4 soap_in_SOAP_ENV__Reason(struct soap*, const char*, struct SOAP_ENV__Reason *, const char*);
SOAP_FMAC1 struct SOAP_ENV__Reason * SOAP_FMAC2 soap_instantiate_SOAP_ENV__Reason(struct soap*, int, const char*, const char*, size_t*);

inline struct SOAP_ENV__Reason * soap_new_SOAP_ENV__Reason(struct soap *soap, int n = -1)
{
	return soap_instantiate_SOAP_ENV__Reason(soap, n, NULL, NULL, NULL);
}

inline struct SOAP_ENV__Reason * soap_new_req_SOAP_ENV__Reason(
	struct soap *soap)
{
	struct SOAP_ENV__Reason *_p = ::soap_new_SOAP_ENV__Reason(soap);
	if (_p)
	{	::soap_default_SOAP_ENV__Reason(soap, _p);
	}
	return _p;
}

inline struct SOAP_ENV__Reason * soap_new_set_SOAP_ENV__Reason(
	struct soap *soap,
	char *SOAP_ENV__Text)
{
	struct SOAP_ENV__Reason *_p = ::soap_new_SOAP_ENV__Reason(soap);
	if (_p)
	{	::soap_default_SOAP_ENV__Reason(soap, _p);
		_p->SOAP_ENV__Text = SOAP_ENV__Text;
	}
	return _p;
}
SOAP_FMAC3 int SOAP_FMAC4 soap_put_SOAP_ENV__Reason(struct soap*, const struct SOAP_ENV__Reason *, const char*, const char*);

inline int soap_write_SOAP_ENV__Reason(struct soap *soap, struct SOAP_ENV__Reason const*p)
{
	soap_free_temp(soap);
	if (soap_begin_send(soap) || (::soap_serialize_SOAP_ENV__Reason(soap, p), 0) || ::soap_put_SOAP_ENV__Reason(soap, p, "SOAP-ENV:Reason", "") || soap_end_send(soap))
			return soap->error;
	return SOAP_OK;
}

inline int soap_PUT_SOAP_ENV__Reason(struct soap *soap, const char *URL, struct SOAP_ENV__Reason const*p)
{
	soap_free_temp(soap);
	if (soap_PUT(soap, URL, NULL, "text/xml; charset=utf-8") || (::soap_serialize_SOAP_ENV__Reason(soap, p), 0) || ::soap_put_SOAP_ENV__Reason(soap, p, "SOAP-ENV:Reason", "") || soap_end_send(soap) || soap_recv_empty_response(soap))
		return soap_closesock(soap);
	return SOAP_OK;
}

inline int soap_PATCH_SOAP_ENV__Reason(struct soap *soap, const char *URL, struct SOAP_ENV__Reason const*p)
{
	soap_free_temp(soap);
	if (soap_PATCH(soap, URL, NULL, "text/xml; charset=utf-8") || (::soap_serialize_SOAP_ENV__Reason(soap, p), 0) || ::soap_put_SOAP_ENV__Reason(soap, p, "SOAP-ENV:Reason", "") || soap_end_send(soap) || soap_recv_empty_response(soap))
		return soap_closesock(soap);
	return SOAP_OK;
}

inline int soap_POST_send_SOAP_ENV__Reason(struct soap *soap, const char *URL, struct SOAP_ENV__Reason const*p)
{
	soap_free_temp(soap);
	if (soap_POST(soap, URL, NULL, "text/xml; charset=utf-8") || (::soap_serialize_SOAP_ENV__Reason(soap, p), 0) || ::soap_put_SOAP_ENV__Reason(soap, p, "SOAP-ENV:Reason", "") || soap_end_send(soap))
		return soap_closesock(soap);
	return SOAP_OK;
}
SOAP_FMAC3 struct SOAP_ENV__Reason * SOAP_FMAC4 soap_get_SOAP_ENV__Reason(struct soap*, struct SOAP_ENV__Reason *, const char*, const char*);

inline int soap_read_SOAP_ENV__Reason(struct soap *soap, struct SOAP_ENV__Reason *p)
{
	if (p)
	{	::soap_default_SOAP_ENV__Reason(soap, p);
		if (soap_begin_recv(soap) || ::soap_get_SOAP_ENV__Reason(soap, p, NULL, NULL) == NULL || soap_end_recv(soap))
			return soap->error;
	}
	return SOAP_OK;
}

inline int soap_GET_SOAP_ENV__Reason(struct soap *soap, const char *URL, struct SOAP_ENV__Reason *p)
{
	if (soap_GET(soap, URL, NULL) || ::soap_read_SOAP_ENV__Reason(soap, p))
		return soap_closesock(soap);
	return soap_closesock(soap);
}

inline int soap_POST_recv_SOAP_ENV__Reason(struct soap *soap, struct SOAP_ENV__Reason *p)
{
	if (::soap_read_SOAP_ENV__Reason(soap, p))
		return soap_closesock(soap);
	return soap_closesock(soap);
}
#endif

#endif

#ifndef WITH_NOGLOBAL

#ifndef SOAP_TYPE_SOAP_ENV__Detail_DEFINED
#define SOAP_TYPE_SOAP_ENV__Detail_DEFINED
SOAP_FMAC3 void SOAP_FMAC4 soap_default_SOAP_ENV__Detail(struct soap*, struct SOAP_ENV__Detail *);
SOAP_FMAC3 void SOAP_FMAC4 soap_serialize_SOAP_ENV__Detail(struct soap*, const struct SOAP_ENV__Detail *);
SOAP_FMAC3 int SOAP_FMAC4 soap_out_SOAP_ENV__Detail(struct soap*, const char*, int, const struct SOAP_ENV__Detail *, const char*);
SOAP_FMAC3 struct SOAP_ENV__Detail * SOAP_FMAC4 soap_in_SOAP_ENV__Detail(struct soap*, const char*, struct SOAP_ENV__Detail *, const char*);
SOAP_FMAC1 struct SOAP_ENV__Detail * SOAP_FMAC2 soap_instantiate_SOAP_ENV__Detail(struct soap*, int, const char*, const char*, size_t*);

inline struct SOAP_ENV__Detail * soap_new_SOAP_ENV__Detail(struct soap *soap, int n = -1)
{
	return soap_instantiate_SOAP_ENV__Detail(soap, n, NULL, NULL, NULL);
}

inline struct SOAP_ENV__Detail * soap_new_req_SOAP_ENV__Detail(
	struct soap *soap,
	int __type,
	void *fault)
{
	struct SOAP_ENV__Detail *_p = ::soap_new_SOAP_ENV__Detail(soap);
	if (_p)
	{	::soap_default_SOAP_ENV__Detail(soap, _p);
		_p->__type = __type;
		_p->fault = fault;
	}
	return _p;
}

inline struct SOAP_ENV__Detail * soap_new_set_SOAP_ENV__Detail(
	struct soap *soap,
	char *__any,
	int __type,
	void *fault)
{
	struct SOAP_ENV__Detail *_p = ::soap_new_SOAP_ENV__Detail(soap);
	if (_p)
	{	::soap_default_SOAP_ENV__Detail(soap, _p);
		_p->__any = __any;
		_p->__type = __type;
		_p->fault = fault;
	}
	return _p;
}
SOAP_FMAC3 int SOAP_FMAC4 soap_put_SOAP_ENV__Detail(struct soap*, const struct SOAP_ENV__Detail *, const char*, const char*);

inline int soap_write_SOAP_ENV__Detail(struct soap *soap, struct SOAP_ENV__Detail const*p)
{
	soap_free_temp(soap);
	if (soap_begin_send(soap) || (::soap_serialize_SOAP_ENV__Detail(soap, p), 0) || ::soap_put_SOAP_ENV__Detail(soap, p, "SOAP-ENV:Detail", "") || soap_end_send(soap))
			return soap->error;
	return SOAP_OK;
}

inline int soap_PUT_SOAP_ENV__Detail(struct soap *soap, const char *URL, struct SOAP_ENV__Detail const*p)
{
	soap_free_temp(soap);
	if (soap_PUT(soap, URL, NULL, "text/xml; charset=utf-8") || (::soap_serialize_SOAP_ENV__Detail(soap, p), 0) || ::soap_put_SOAP_ENV__Detail(soap, p, "SOAP-ENV:Detail", "") || soap_end_send(soap) || soap_recv_empty_response(soap))
		return soap_closesock(soap);
	return SOAP_OK;
}

inline int soap_PATCH_SOAP_ENV__Detail(struct soap *soap, const char *URL, struct SOAP_ENV__Detail const*p)
{
	soap_free_temp(soap);
	if (soap_PATCH(soap, URL, NULL, "text/xml; charset=utf-8") || (::soap_serialize_SOAP_ENV__Detail(soap, p), 0) || ::soap_put_SOAP_ENV__Detail(soap, p, "SOAP-ENV:Detail", "") || soap_end_send(soap) || soap_recv_empty_response(soap))
		return soap_closesock(soap);
	return SOAP_OK;
}

inline int soap_POST_send_SOAP_ENV__Detail(struct soap *soap, const char *URL, struct SOAP_ENV__Detail const*p)
{
	soap_free_temp(soap);
	if (soap_POST(soap, URL, NULL, "text/xml; charset=utf-8") || (::soap_serialize_SOAP_ENV__Detail(soap, p), 0) || ::soap_put_SOAP_ENV__Detail(soap, p, "SOAP-ENV:Detail", "") || soap_end_send(soap))
		return soap_closesock(soap);
	return SOAP_OK;
}
SOAP_FMAC3 struct SOAP_ENV__Detail * SOAP_FMAC4 soap_get_SOAP_ENV__Detail(struct soap*, struct SOAP_ENV__Detail *, const char*, const char*);

inline int soap_read_SOAP_ENV__Detail(struct soap *soap, struct SOAP_ENV__Detail *p)
{
	if (p)
	{	::soap_default_SOAP_ENV__Detail(soap, p);
		if (soap_begin_recv(soap) || ::soap_get_SOAP_ENV__Detail(soap, p, NULL, NULL) == NULL || soap_end_recv(soap))
			return soap->error;
	}
	return SOAP_OK;
}

inline int soap_GET_SOAP_ENV__Detail(struct soap *soap, const char *URL, struct SOAP_ENV__Detail *p)
{
	if (soap_GET(soap, URL, NULL) || ::soap_read_SOAP_ENV__Detail(soap, p))
		return soap_closesock(soap);
	return soap_closesock(soap);
}

inline int soap_POST_recv_SOAP_ENV__Detail(struct soap *soap, struct SOAP_ENV__Detail *p)
{
	if (::soap_read_SOAP_ENV__Detail(soap, p))
		return soap_closesock(soap);
	return soap_closesock(soap);
}
#endif

#endif

#ifndef WITH_NOGLOBAL

#ifndef SOAP_TYPE_SOAP_ENV__Code_DEFINED
#define SOAP_TYPE_SOAP_ENV__Code_DEFINED
SOAP_FMAC3 void SOAP_FMAC4 soap_default_SOAP_ENV__Code(struct soap*, struct SOAP_ENV__Code *);
SOAP_FMAC3 void SOAP_FMAC4 soap_serialize_SOAP_ENV__Code(struct soap*, const struct SOAP_ENV__Code *);
SOAP_FMAC3 int SOAP_FMAC4 soap_out_SOAP_ENV__Code(struct soap*, const char*, int, const struct SOAP_ENV__Code *, const char*);
SOAP_FMAC3 struct SOAP_ENV__Code * SOAP_FMAC4 soap_in_SOAP_ENV__Code(struct soap*, const char*, struct SOAP_ENV__Code *, const char*);
SOAP_FMAC1 struct SOAP_ENV__Code * SOAP_FMAC2 soap_instantiate_SOAP_ENV__Code(struct soap*, int, const char*, const char*, size_t*);

inline struct SOAP_ENV__Code * soap_new_SOAP_ENV__Code(struct soap *soap, int n = -1)
{
	return soap_instantiate_SOAP_ENV__Code(soap, n, NULL, NULL, NULL);
}

inline struct SOAP_ENV__Code * soap_new_req_SOAP_ENV__Code(
	struct soap *soap)
{
	struct SOAP_ENV__Code *_p = ::soap_new_SOAP_ENV__Code(soap);
	if (_p)
	{	::soap_default_SOAP_ENV__Code(soap, _p);
	}
	return _p;
}

inline struct SOAP_ENV__Code * soap_new_set_SOAP_ENV__Code(
	struct soap *soap,
	char *SOAP_ENV__Value,
	struct SOAP_ENV__Code *SOAP_ENV__Subcode)
{
	struct SOAP_ENV__Code *_p = ::soap_new_SOAP_ENV__Code(soap);
	if (_p)
	{	::soap_default_SOAP_ENV__Code(soap, _p);
		_p->SOAP_ENV__Value = SOAP_ENV__Value;
		_p->SOAP_ENV__Subcode = SOAP_ENV__Subcode;
	}
	return _p;
}
SOAP_FMAC3 int SOAP_FMAC4 soap_put_SOAP_ENV__Code(struct soap*, const struct SOAP_ENV__Code *, const char*, const char*);

inline int soap_write_SOAP_ENV__Code(struct soap *soap, struct SOAP_ENV__Code const*p)
{
	soap_free_temp(soap);
	if (soap_begin_send(soap) || (::soap_serialize_SOAP_ENV__Code(soap, p), 0) || ::soap_put_SOAP_ENV__Code(soap, p, "SOAP-ENV:Code", "") || soap_end_send(soap))
			return soap->error;
	return SOAP_OK;
}

inline int soap_PUT_SOAP_ENV__Code(struct soap *soap, const char *URL, struct SOAP_ENV__Code const*p)
{
	soap_free_temp(soap);
	if (soap_PUT(soap, URL, NULL, "text/xml; charset=utf-8") || (::soap_serialize_SOAP_ENV__Code(soap, p), 0) || ::soap_put_SOAP_ENV__Code(soap, p, "SOAP-ENV:Code", "") || soap_end_send(soap) || soap_recv_empty_response(soap))
		return soap_closesock(soap);
	return SOAP_OK;
}

inline int soap_PATCH_SOAP_ENV__Code(struct soap *soap, const char *URL, struct SOAP_ENV__Code const*p)
{
	soap_free_temp(soap);
	if (soap_PATCH(soap, URL, NULL, "text/xml; charset=utf-8") || (::soap_serialize_SOAP_ENV__Code(soap, p), 0) || ::soap_put_SOAP_ENV__Code(soap, p, "SOAP-ENV:Code", "") || soap_end_send(soap) || soap_recv_empty_response(soap))
		return soap_closesock(soap);
	return SOAP_OK;
}

inline int soap_POST_send_SOAP_ENV__Code(struct soap *soap, const char *URL, struct SOAP_ENV__Code const*p)
{
	soap_free_temp(soap);
	if (soap_POST(soap, URL, NULL, "text/xml; charset=utf-8") || (::soap_serialize_SOAP_ENV__Code(soap, p), 0) || ::soap_put_SOAP_ENV__Code(soap, p, "SOAP-ENV:Code", "") || soap_end_send(soap))
		return soap_closesock(soap);
	return SOAP_OK;
}
SOAP_FMAC3 struct SOAP_ENV__Code * SOAP_FMAC4 soap_get_SOAP_ENV__Code(struct soap*, struct SOAP_ENV__Code *, const char*, const char*);

inline int soap_read_SOAP_ENV__Code(struct soap *soap, struct SOAP_ENV__Code *p)
{
	if (p)
	{	::soap_default_SOAP_ENV__Code(soap, p);
		if (soap_begin_recv(soap) || ::soap_get_SOAP_ENV__Code(soap, p, NULL, NULL) == NULL || soap_end_recv(soap))
			return soap->error;
	}
	return SOAP_OK;
}

inline int soap_GET_SOAP_ENV__Code(struct soap *soap, const char *URL, struct SOAP_ENV__Code *p)
{
	if (soap_GET(soap, URL, NULL) || ::soap_read_SOAP_ENV__Code(soap, p))
		return soap_closesock(soap);
	return soap_closesock(soap);
}

inline int soap_POST_recv_SOAP_ENV__Code(struct soap *soap, struct SOAP_ENV__Code *p)
{
	if (::soap_read_SOAP_ENV__Code(soap, p))
		return soap_closesock(soap);
	return soap_closesock(soap);
}
#endif

#endif

#ifndef WITH_NOGLOBAL

#ifndef SOAP_TYPE_SOAP_ENV__Header_DEFINED
#define SOAP_TYPE_SOAP_ENV__Header_DEFINED
SOAP_FMAC3 void SOAP_FMAC4 soap_default_SOAP_ENV__Header(struct soap*, struct SOAP_ENV__Header *);
SOAP_FMAC3 void SOAP_FMAC4 soap_serialize_SOAP_ENV__Header(struct soap*, const struct SOAP_ENV__Header *);
SOAP_FMAC3 int SOAP_FMAC4 soap_out_SOAP_ENV__Header(struct soap*, const char*, int, const struct SOAP_ENV__Header *, const char*);
SOAP_FMAC3 struct SOAP_ENV__Header * SOAP_FMAC4 soap_in_SOAP_ENV__Header(struct soap*, const char*, struct SOAP_ENV__Header *, const char*);
SOAP_FMAC1 struct SOAP_ENV__Header * SOAP_FMAC2 soap_instantiate_SOAP_ENV__Header(struct soap*, int, const char*, const char*, size_t*);

inline struct SOAP_ENV__Header * soap_new_SOAP_ENV__Header(struct soap *soap, int n = -1)
{
	return soap_instantiate_SOAP_ENV__Header(soap, n, NULL, NULL, NULL);
}

inline struct SOAP_ENV__Header * soap_new_req_SOAP_ENV__Header(
	struct soap *soap)
{
	struct SOAP_ENV__Header *_p = ::soap_new_SOAP_ENV__Header(soap);
	if (_p)
	{	::soap_default_SOAP_ENV__Header(soap, _p);
	}
	return _p;
}

inline struct SOAP_ENV__Header * soap_new_set_SOAP_ENV__Header(
	struct soap *soap)
{
	struct SOAP_ENV__Header *_p = ::soap_new_SOAP_ENV__Header(soap);
	if (_p)
	{	::soap_default_SOAP_ENV__Header(soap, _p);
	}
	return _p;
}
SOAP_FMAC3 int SOAP_FMAC4 soap_put_SOAP_ENV__Header(struct soap*, const struct SOAP_ENV__Header *, const char*, const char*);

inline int soap_write_SOAP_ENV__Header(struct soap *soap, struct SOAP_ENV__Header const*p)
{
	soap_free_temp(soap);
	if (soap_begin_send(soap) || (::soap_serialize_SOAP_ENV__Header(soap, p), 0) || ::soap_put_SOAP_ENV__Header(soap, p, "SOAP-ENV:Header", "") || soap_end_send(soap))
			return soap->error;
	return SOAP_OK;
}

inline int soap_PUT_SOAP_ENV__Header(struct soap *soap, const char *URL, struct SOAP_ENV__Header const*p)
{
	soap_free_temp(soap);
	if (soap_PUT(soap, URL, NULL, "text/xml; charset=utf-8") || (::soap_serialize_SOAP_ENV__Header(soap, p), 0) || ::soap_put_SOAP_ENV__Header(soap, p, "SOAP-ENV:Header", "") || soap_end_send(soap) || soap_recv_empty_response(soap))
		return soap_closesock(soap);
	return SOAP_OK;
}

inline int soap_PATCH_SOAP_ENV__Header(struct soap *soap, const char *URL, struct SOAP_ENV__Header const*p)
{
	soap_free_temp(soap);
	if (soap_PATCH(soap, URL, NULL, "text/xml; charset=utf-8") || (::soap_serialize_SOAP_ENV__Header(soap, p), 0) || ::soap_put_SOAP_ENV__Header(soap, p, "SOAP-ENV:Header", "") || soap_end_send(soap) || soap_recv_empty_response(soap))
		return soap_closesock(soap);
	return SOAP_OK;
}

inline int soap_POST_send_SOAP_ENV__Header(struct soap *soap, const char *URL, struct SOAP_ENV__Header const*p)
{
	soap_free_temp(soap);
	if (soap_POST(soap, URL, NULL, "text/xml; charset=utf-8") || (::soap_serialize_SOAP_ENV__Header(soap, p), 0) || ::soap_put_SOAP_ENV__Header(soap, p, "SOAP-ENV:Header", "") || soap_end_send(soap))
		return soap_closesock(soap);
	return SOAP_OK;
}
SOAP_FMAC3 struct SOAP_ENV__Header * SOAP_FMAC4 soap_get_SOAP_ENV__Header(struct soap*, struct SOAP_ENV__Header *, const char*, const char*);

inline int soap_read_SOAP_ENV__Header(struct soap *soap, struct SOAP_ENV__Header *p)
{
	if (p)
	{	::soap_default_SOAP_ENV__Header(soap, p);
		if (soap_begin_recv(soap) || ::soap_get_SOAP_ENV__Header(soap, p, NULL, NULL) == NULL || soap_end_recv(soap))
			return soap->error;
	}
	return SOAP_OK;
}

inline int soap_GET_SOAP_ENV__Header(struct soap *soap, const char *URL, struct SOAP_ENV__Header *p)
{
	if (soap_GET(soap, URL, NULL) || ::soap_read_SOAP_ENV__Header(soap, p))
		return soap_closesock(soap);
	return soap_closesock(soap);
}

inline int soap_POST_recv_SOAP_ENV__Header(struct soap *soap, struct SOAP_ENV__Header *p)
{
	if (::soap_read_SOAP_ENV__Header(soap, p))
		return soap_closesock(soap);
	return soap_closesock(soap);
}
#endif

#endif

#ifndef SOAP_TYPE_api__login_by_key_DEFINED
#define SOAP_TYPE_api__login_by_key_DEFINED
SOAP_FMAC3 void SOAP_FMAC4 soap_default_api__login_by_key(struct soap*, struct api__login_by_key *);
SOAP_FMAC3 void SOAP_FMAC4 soap_serialize_api__login_by_key(struct soap*, const struct api__login_by_key *);
SOAP_FMAC3 int SOAP_FMAC4 soap_out_api__login_by_key(struct soap*, const char*, int, const struct api__login_by_key *, const char*);
SOAP_FMAC3 struct api__login_by_key * SOAP_FMAC4 soap_in_api__login_by_key(struct soap*, const char*, struct api__login_by_key *, const char*);
SOAP_FMAC1 struct api__login_by_key * SOAP_FMAC2 soap_instantiate_api__login_by_key(struct soap*, int, const char*, const char*, size_t*);

inline struct api__login_by_key * soap_new_api__login_by_key(struct soap *soap, int n = -1)
{
	return soap_instantiate_api__login_by_key(soap, n, NULL, NULL, NULL);
}

inline struct api__login_by_key * soap_new_req_api__login_by_key(
	struct soap *soap)
{
	struct api__login_by_key *_p = ::soap_new_api__login_by_key(soap);
	if (_p)
	{	::soap_default_api__login_by_key(soap, _p);
	}
	return _p;
}

inline struct api__login_by_key * soap_new_set_api__login_by_key(
	struct soap *soap,
	char *usr,
	char *psw)
{
	struct api__login_by_key *_p = ::soap_new_api__login_by_key(soap);
	if (_p)
	{	::soap_default_api__login_by_key(soap, _p);
		_p->usr = usr;
		_p->psw = psw;
	}
	return _p;
}
SOAP_FMAC3 int SOAP_FMAC4 soap_put_api__login_by_key(struct soap*, const struct api__login_by_key *, const char*, const char*);

inline int soap_write_api__login_by_key(struct soap *soap, struct api__login_by_key const*p)
{
	soap_free_temp(soap);
	if (soap_begin_send(soap) || (::soap_serialize_api__login_by_key(soap, p), 0) || ::soap_put_api__login_by_key(soap, p, "api:login-by-key", "") || soap_end_send(soap))
			return soap->error;
	return SOAP_OK;
}

inline int soap_PUT_api__login_by_key(struct soap *soap, const char *URL, struct api__login_by_key const*p)
{
	soap_free_temp(soap);
	if (soap_PUT(soap, URL, NULL, "text/xml; charset=utf-8") || (::soap_serialize_api__login_by_key(soap, p), 0) || ::soap_put_api__login_by_key(soap, p, "api:login-by-key", "") || soap_end_send(soap) || soap_recv_empty_response(soap))
		return soap_closesock(soap);
	return SOAP_OK;
}

inline int soap_PATCH_api__login_by_key(struct soap *soap, const char *URL, struct api__login_by_key const*p)
{
	soap_free_temp(soap);
	if (soap_PATCH(soap, URL, NULL, "text/xml; charset=utf-8") || (::soap_serialize_api__login_by_key(soap, p), 0) || ::soap_put_api__login_by_key(soap, p, "api:login-by-key", "") || soap_end_send(soap) || soap_recv_empty_response(soap))
		return soap_closesock(soap);
	return SOAP_OK;
}

inline int soap_POST_send_api__login_by_key(struct soap *soap, const char *URL, struct api__login_by_key const*p)
{
	soap_free_temp(soap);
	if (soap_POST(soap, URL, NULL, "text/xml; charset=utf-8") || (::soap_serialize_api__login_by_key(soap, p), 0) || ::soap_put_api__login_by_key(soap, p, "api:login-by-key", "") || soap_end_send(soap))
		return soap_closesock(soap);
	return SOAP_OK;
}
SOAP_FMAC3 struct api__login_by_key * SOAP_FMAC4 soap_get_api__login_by_key(struct soap*, struct api__login_by_key *, const char*, const char*);

inline int soap_read_api__login_by_key(struct soap *soap, struct api__login_by_key *p)
{
	if (p)
	{	::soap_default_api__login_by_key(soap, p);
		if (soap_begin_recv(soap) || ::soap_get_api__login_by_key(soap, p, NULL, NULL) == NULL || soap_end_recv(soap))
			return soap->error;
	}
	return SOAP_OK;
}

inline int soap_GET_api__login_by_key(struct soap *soap, const char *URL, struct api__login_by_key *p)
{
	if (soap_GET(soap, URL, NULL) || ::soap_read_api__login_by_key(soap, p))
		return soap_closesock(soap);
	return soap_closesock(soap);
}

inline int soap_POST_recv_api__login_by_key(struct soap *soap, struct api__login_by_key *p)
{
	if (::soap_read_api__login_by_key(soap, p))
		return soap_closesock(soap);
	return soap_closesock(soap);
}
#endif

#ifndef SOAP_TYPE_api__get_server_status_DEFINED
#define SOAP_TYPE_api__get_server_status_DEFINED
SOAP_FMAC3 void SOAP_FMAC4 soap_default_api__get_server_status(struct soap*, struct api__get_server_status *);
SOAP_FMAC3 void SOAP_FMAC4 soap_serialize_api__get_server_status(struct soap*, const struct api__get_server_status *);
SOAP_FMAC3 int SOAP_FMAC4 soap_out_api__get_server_status(struct soap*, const char*, int, const struct api__get_server_status *, const char*);
SOAP_FMAC3 struct api__get_server_status * SOAP_FMAC4 soap_in_api__get_server_status(struct soap*, const char*, struct api__get_server_status *, const char*);
SOAP_FMAC1 struct api__get_server_status * SOAP_FMAC2 soap_instantiate_api__get_server_status(struct soap*, int, const char*, const char*, size_t*);

inline struct api__get_server_status * soap_new_api__get_server_status(struct soap *soap, int n = -1)
{
	return soap_instantiate_api__get_server_status(soap, n, NULL, NULL, NULL);
}

inline struct api__get_server_status * soap_new_req_api__get_server_status(
	struct soap *soap)
{
	struct api__get_server_status *_p = ::soap_new_api__get_server_status(soap);
	if (_p)
	{	::soap_default_api__get_server_status(soap, _p);
	}
	return _p;
}

inline struct api__get_server_status * soap_new_set_api__get_server_status(
	struct soap *soap,
	char *req)
{
	struct api__get_server_status *_p = ::soap_new_api__get_server_status(soap);
	if (_p)
	{	::soap_default_api__get_server_status(soap, _p);
		_p->req = req;
	}
	return _p;
}
SOAP_FMAC3 int SOAP_FMAC4 soap_put_api__get_server_status(struct soap*, const struct api__get_server_status *, const char*, const char*);

inline int soap_write_api__get_server_status(struct soap *soap, struct api__get_server_status const*p)
{
	soap_free_temp(soap);
	if (soap_begin_send(soap) || (::soap_serialize_api__get_server_status(soap, p), 0) || ::soap_put_api__get_server_status(soap, p, "api:get-server-status", "") || soap_end_send(soap))
			return soap->error;
	return SOAP_OK;
}

inline int soap_PUT_api__get_server_status(struct soap *soap, const char *URL, struct api__get_server_status const*p)
{
	soap_free_temp(soap);
	if (soap_PUT(soap, URL, NULL, "text/xml; charset=utf-8") || (::soap_serialize_api__get_server_status(soap, p), 0) || ::soap_put_api__get_server_status(soap, p, "api:get-server-status", "") || soap_end_send(soap) || soap_recv_empty_response(soap))
		return soap_closesock(soap);
	return SOAP_OK;
}

inline int soap_PATCH_api__get_server_status(struct soap *soap, const char *URL, struct api__get_server_status const*p)
{
	soap_free_temp(soap);
	if (soap_PATCH(soap, URL, NULL, "text/xml; charset=utf-8") || (::soap_serialize_api__get_server_status(soap, p), 0) || ::soap_put_api__get_server_status(soap, p, "api:get-server-status", "") || soap_end_send(soap) || soap_recv_empty_response(soap))
		return soap_closesock(soap);
	return SOAP_OK;
}

inline int soap_POST_send_api__get_server_status(struct soap *soap, const char *URL, struct api__get_server_status const*p)
{
	soap_free_temp(soap);
	if (soap_POST(soap, URL, NULL, "text/xml; charset=utf-8") || (::soap_serialize_api__get_server_status(soap, p), 0) || ::soap_put_api__get_server_status(soap, p, "api:get-server-status", "") || soap_end_send(soap))
		return soap_closesock(soap);
	return SOAP_OK;
}
SOAP_FMAC3 struct api__get_server_status * SOAP_FMAC4 soap_get_api__get_server_status(struct soap*, struct api__get_server_status *, const char*, const char*);

inline int soap_read_api__get_server_status(struct soap *soap, struct api__get_server_status *p)
{
	if (p)
	{	::soap_default_api__get_server_status(soap, p);
		if (soap_begin_recv(soap) || ::soap_get_api__get_server_status(soap, p, NULL, NULL) == NULL || soap_end_recv(soap))
			return soap->error;
	}
	return SOAP_OK;
}

inline int soap_GET_api__get_server_status(struct soap *soap, const char *URL, struct api__get_server_status *p)
{
	if (soap_GET(soap, URL, NULL) || ::soap_read_api__get_server_status(soap, p))
		return soap_closesock(soap);
	return soap_closesock(soap);
}

inline int soap_POST_recv_api__get_server_status(struct soap *soap, struct api__get_server_status *p)
{
	if (::soap_read_api__get_server_status(soap, p))
		return soap_closesock(soap);
	return soap_closesock(soap);
}
#endif

#ifndef SOAP_TYPE_api__get_server_statusResponse_DEFINED
#define SOAP_TYPE_api__get_server_statusResponse_DEFINED
SOAP_FMAC3 void SOAP_FMAC4 soap_default_api__get_server_statusResponse(struct soap*, struct api__get_server_statusResponse *);
SOAP_FMAC3 void SOAP_FMAC4 soap_serialize_api__get_server_statusResponse(struct soap*, const struct api__get_server_statusResponse *);
SOAP_FMAC3 int SOAP_FMAC4 soap_out_api__get_server_statusResponse(struct soap*, const char*, int, const struct api__get_server_statusResponse *, const char*);
SOAP_FMAC3 struct api__get_server_statusResponse * SOAP_FMAC4 soap_in_api__get_server_statusResponse(struct soap*, const char*, struct api__get_server_statusResponse *, const char*);
SOAP_FMAC1 struct api__get_server_statusResponse * SOAP_FMAC2 soap_instantiate_api__get_server_statusResponse(struct soap*, int, const char*, const char*, size_t*);

inline struct api__get_server_statusResponse * soap_new_api__get_server_statusResponse(struct soap *soap, int n = -1)
{
	return soap_instantiate_api__get_server_statusResponse(soap, n, NULL, NULL, NULL);
}

inline struct api__get_server_statusResponse * soap_new_req_api__get_server_statusResponse(
	struct soap *soap,
	char *rsp)
{
	struct api__get_server_statusResponse *_p = ::soap_new_api__get_server_statusResponse(soap);
	if (_p)
	{	::soap_default_api__get_server_statusResponse(soap, _p);
		_p->rsp = rsp;
	}
	return _p;
}

inline struct api__get_server_statusResponse * soap_new_set_api__get_server_statusResponse(
	struct soap *soap,
	char *rsp)
{
	struct api__get_server_statusResponse *_p = ::soap_new_api__get_server_statusResponse(soap);
	if (_p)
	{	::soap_default_api__get_server_statusResponse(soap, _p);
		_p->rsp = rsp;
	}
	return _p;
}
SOAP_FMAC3 int SOAP_FMAC4 soap_put_api__get_server_statusResponse(struct soap*, const struct api__get_server_statusResponse *, const char*, const char*);

inline int soap_write_api__get_server_statusResponse(struct soap *soap, struct api__get_server_statusResponse const*p)
{
	soap_free_temp(soap);
	if (soap_begin_send(soap) || (::soap_serialize_api__get_server_statusResponse(soap, p), 0) || ::soap_put_api__get_server_statusResponse(soap, p, "api:get-server-statusResponse", "") || soap_end_send(soap))
			return soap->error;
	return SOAP_OK;
}

inline int soap_PUT_api__get_server_statusResponse(struct soap *soap, const char *URL, struct api__get_server_statusResponse const*p)
{
	soap_free_temp(soap);
	if (soap_PUT(soap, URL, NULL, "text/xml; charset=utf-8") || (::soap_serialize_api__get_server_statusResponse(soap, p), 0) || ::soap_put_api__get_server_statusResponse(soap, p, "api:get-server-statusResponse", "") || soap_end_send(soap) || soap_recv_empty_response(soap))
		return soap_closesock(soap);
	return SOAP_OK;
}

inline int soap_PATCH_api__get_server_statusResponse(struct soap *soap, const char *URL, struct api__get_server_statusResponse const*p)
{
	soap_free_temp(soap);
	if (soap_PATCH(soap, URL, NULL, "text/xml; charset=utf-8") || (::soap_serialize_api__get_server_statusResponse(soap, p), 0) || ::soap_put_api__get_server_statusResponse(soap, p, "api:get-server-statusResponse", "") || soap_end_send(soap) || soap_recv_empty_response(soap))
		return soap_closesock(soap);
	return SOAP_OK;
}

inline int soap_POST_send_api__get_server_statusResponse(struct soap *soap, const char *URL, struct api__get_server_statusResponse const*p)
{
	soap_free_temp(soap);
	if (soap_POST(soap, URL, NULL, "text/xml; charset=utf-8") || (::soap_serialize_api__get_server_statusResponse(soap, p), 0) || ::soap_put_api__get_server_statusResponse(soap, p, "api:get-server-statusResponse", "") || soap_end_send(soap))
		return soap_closesock(soap);
	return SOAP_OK;
}
SOAP_FMAC3 struct api__get_server_statusResponse * SOAP_FMAC4 soap_get_api__get_server_statusResponse(struct soap*, struct api__get_server_statusResponse *, const char*, const char*);

inline int soap_read_api__get_server_statusResponse(struct soap *soap, struct api__get_server_statusResponse *p)
{
	if (p)
	{	::soap_default_api__get_server_statusResponse(soap, p);
		if (soap_begin_recv(soap) || ::soap_get_api__get_server_statusResponse(soap, p, NULL, NULL) == NULL || soap_end_recv(soap))
			return soap->error;
	}
	return SOAP_OK;
}

inline int soap_GET_api__get_server_statusResponse(struct soap *soap, const char *URL, struct api__get_server_statusResponse *p)
{
	if (soap_GET(soap, URL, NULL) || ::soap_read_api__get_server_statusResponse(soap, p))
		return soap_closesock(soap);
	return soap_closesock(soap);
}

inline int soap_POST_recv_api__get_server_statusResponse(struct soap *soap, struct api__get_server_statusResponse *p)
{
	if (::soap_read_api__get_server_statusResponse(soap, p))
		return soap_closesock(soap);
	return soap_closesock(soap);
}
#endif

#ifndef SOAP_TYPE_api__trans_DEFINED
#define SOAP_TYPE_api__trans_DEFINED
SOAP_FMAC3 void SOAP_FMAC4 soap_default_api__trans(struct soap*, struct api__trans *);
SOAP_FMAC3 void SOAP_FMAC4 soap_serialize_api__trans(struct soap*, const struct api__trans *);
SOAP_FMAC3 int SOAP_FMAC4 soap_out_api__trans(struct soap*, const char*, int, const struct api__trans *, const char*);
SOAP_FMAC3 struct api__trans * SOAP_FMAC4 soap_in_api__trans(struct soap*, const char*, struct api__trans *, const char*);
SOAP_FMAC1 struct api__trans * SOAP_FMAC2 soap_instantiate_api__trans(struct soap*, int, const char*, const char*, size_t*);

inline struct api__trans * soap_new_api__trans(struct soap *soap, int n = -1)
{
	return soap_instantiate_api__trans(soap, n, NULL, NULL, NULL);
}

inline struct api__trans * soap_new_req_api__trans(
	struct soap *soap)
{
	struct api__trans *_p = ::soap_new_api__trans(soap);
	if (_p)
	{	::soap_default_api__trans(soap, _p);
	}
	return _p;
}

inline struct api__trans * soap_new_set_api__trans(
	struct soap *soap,
	char *msg)
{
	struct api__trans *_p = ::soap_new_api__trans(soap);
	if (_p)
	{	::soap_default_api__trans(soap, _p);
		_p->msg = msg;
	}
	return _p;
}
SOAP_FMAC3 int SOAP_FMAC4 soap_put_api__trans(struct soap*, const struct api__trans *, const char*, const char*);

inline int soap_write_api__trans(struct soap *soap, struct api__trans const*p)
{
	soap_free_temp(soap);
	if (soap_begin_send(soap) || (::soap_serialize_api__trans(soap, p), 0) || ::soap_put_api__trans(soap, p, "api:trans", "") || soap_end_send(soap))
			return soap->error;
	return SOAP_OK;
}

inline int soap_PUT_api__trans(struct soap *soap, const char *URL, struct api__trans const*p)
{
	soap_free_temp(soap);
	if (soap_PUT(soap, URL, NULL, "text/xml; charset=utf-8") || (::soap_serialize_api__trans(soap, p), 0) || ::soap_put_api__trans(soap, p, "api:trans", "") || soap_end_send(soap) || soap_recv_empty_response(soap))
		return soap_closesock(soap);
	return SOAP_OK;
}

inline int soap_PATCH_api__trans(struct soap *soap, const char *URL, struct api__trans const*p)
{
	soap_free_temp(soap);
	if (soap_PATCH(soap, URL, NULL, "text/xml; charset=utf-8") || (::soap_serialize_api__trans(soap, p), 0) || ::soap_put_api__trans(soap, p, "api:trans", "") || soap_end_send(soap) || soap_recv_empty_response(soap))
		return soap_closesock(soap);
	return SOAP_OK;
}

inline int soap_POST_send_api__trans(struct soap *soap, const char *URL, struct api__trans const*p)
{
	soap_free_temp(soap);
	if (soap_POST(soap, URL, NULL, "text/xml; charset=utf-8") || (::soap_serialize_api__trans(soap, p), 0) || ::soap_put_api__trans(soap, p, "api:trans", "") || soap_end_send(soap))
		return soap_closesock(soap);
	return SOAP_OK;
}
SOAP_FMAC3 struct api__trans * SOAP_FMAC4 soap_get_api__trans(struct soap*, struct api__trans *, const char*, const char*);

inline int soap_read_api__trans(struct soap *soap, struct api__trans *p)
{
	if (p)
	{	::soap_default_api__trans(soap, p);
		if (soap_begin_recv(soap) || ::soap_get_api__trans(soap, p, NULL, NULL) == NULL || soap_end_recv(soap))
			return soap->error;
	}
	return SOAP_OK;
}

inline int soap_GET_api__trans(struct soap *soap, const char *URL, struct api__trans *p)
{
	if (soap_GET(soap, URL, NULL) || ::soap_read_api__trans(soap, p))
		return soap_closesock(soap);
	return soap_closesock(soap);
}

inline int soap_POST_recv_api__trans(struct soap *soap, struct api__trans *p)
{
	if (::soap_read_api__trans(soap, p))
		return soap_closesock(soap);
	return soap_closesock(soap);
}
#endif

#ifndef SOAP_TYPE_api__transResponse_DEFINED
#define SOAP_TYPE_api__transResponse_DEFINED
SOAP_FMAC3 void SOAP_FMAC4 soap_default_api__transResponse(struct soap*, struct api__transResponse *);
SOAP_FMAC3 void SOAP_FMAC4 soap_serialize_api__transResponse(struct soap*, const struct api__transResponse *);
SOAP_FMAC3 int SOAP_FMAC4 soap_out_api__transResponse(struct soap*, const char*, int, const struct api__transResponse *, const char*);
SOAP_FMAC3 struct api__transResponse * SOAP_FMAC4 soap_in_api__transResponse(struct soap*, const char*, struct api__transResponse *, const char*);
SOAP_FMAC1 struct api__transResponse * SOAP_FMAC2 soap_instantiate_api__transResponse(struct soap*, int, const char*, const char*, size_t*);

inline struct api__transResponse * soap_new_api__transResponse(struct soap *soap, int n = -1)
{
	return soap_instantiate_api__transResponse(soap, n, NULL, NULL, NULL);
}

inline struct api__transResponse * soap_new_req_api__transResponse(
	struct soap *soap)
{
	struct api__transResponse *_p = ::soap_new_api__transResponse(soap);
	if (_p)
	{	::soap_default_api__transResponse(soap, _p);
	}
	return _p;
}

inline struct api__transResponse * soap_new_set_api__transResponse(
	struct soap *soap,
	char **rtn)
{
	struct api__transResponse *_p = ::soap_new_api__transResponse(soap);
	if (_p)
	{	::soap_default_api__transResponse(soap, _p);
		_p->rtn = rtn;
	}
	return _p;
}
SOAP_FMAC3 int SOAP_FMAC4 soap_put_api__transResponse(struct soap*, const struct api__transResponse *, const char*, const char*);

inline int soap_write_api__transResponse(struct soap *soap, struct api__transResponse const*p)
{
	soap_free_temp(soap);
	if (soap_begin_send(soap) || (::soap_serialize_api__transResponse(soap, p), 0) || ::soap_put_api__transResponse(soap, p, "api:transResponse", "") || soap_end_send(soap))
			return soap->error;
	return SOAP_OK;
}

inline int soap_PUT_api__transResponse(struct soap *soap, const char *URL, struct api__transResponse const*p)
{
	soap_free_temp(soap);
	if (soap_PUT(soap, URL, NULL, "text/xml; charset=utf-8") || (::soap_serialize_api__transResponse(soap, p), 0) || ::soap_put_api__transResponse(soap, p, "api:transResponse", "") || soap_end_send(soap) || soap_recv_empty_response(soap))
		return soap_closesock(soap);
	return SOAP_OK;
}

inline int soap_PATCH_api__transResponse(struct soap *soap, const char *URL, struct api__transResponse const*p)
{
	soap_free_temp(soap);
	if (soap_PATCH(soap, URL, NULL, "text/xml; charset=utf-8") || (::soap_serialize_api__transResponse(soap, p), 0) || ::soap_put_api__transResponse(soap, p, "api:transResponse", "") || soap_end_send(soap) || soap_recv_empty_response(soap))
		return soap_closesock(soap);
	return SOAP_OK;
}

inline int soap_POST_send_api__transResponse(struct soap *soap, const char *URL, struct api__transResponse const*p)
{
	soap_free_temp(soap);
	if (soap_POST(soap, URL, NULL, "text/xml; charset=utf-8") || (::soap_serialize_api__transResponse(soap, p), 0) || ::soap_put_api__transResponse(soap, p, "api:transResponse", "") || soap_end_send(soap))
		return soap_closesock(soap);
	return SOAP_OK;
}
SOAP_FMAC3 struct api__transResponse * SOAP_FMAC4 soap_get_api__transResponse(struct soap*, struct api__transResponse *, const char*, const char*);

inline int soap_read_api__transResponse(struct soap *soap, struct api__transResponse *p)
{
	if (p)
	{	::soap_default_api__transResponse(soap, p);
		if (soap_begin_recv(soap) || ::soap_get_api__transResponse(soap, p, NULL, NULL) == NULL || soap_end_recv(soap))
			return soap->error;
	}
	return SOAP_OK;
}

inline int soap_GET_api__transResponse(struct soap *soap, const char *URL, struct api__transResponse *p)
{
	if (soap_GET(soap, URL, NULL) || ::soap_read_api__transResponse(soap, p))
		return soap_closesock(soap);
	return soap_closesock(soap);
}

inline int soap_POST_recv_api__transResponse(struct soap *soap, struct api__transResponse *p)
{
	if (::soap_read_api__transResponse(soap, p))
		return soap_closesock(soap);
	return soap_closesock(soap);
}
#endif

#ifndef SOAP_TYPE_api__ArrayOfEmp2_DEFINED
#define SOAP_TYPE_api__ArrayOfEmp2_DEFINED
SOAP_FMAC3 void SOAP_FMAC4 soap_default_api__ArrayOfEmp2(struct soap*, struct api__ArrayOfEmp2 *);
SOAP_FMAC3 void SOAP_FMAC4 soap_serialize_api__ArrayOfEmp2(struct soap*, const struct api__ArrayOfEmp2 *);
SOAP_FMAC3 int SOAP_FMAC4 soap_out_api__ArrayOfEmp2(struct soap*, const char*, int, const struct api__ArrayOfEmp2 *, const char*);
SOAP_FMAC3 struct api__ArrayOfEmp2 * SOAP_FMAC4 soap_in_api__ArrayOfEmp2(struct soap*, const char*, struct api__ArrayOfEmp2 *, const char*);
SOAP_FMAC1 struct api__ArrayOfEmp2 * SOAP_FMAC2 soap_instantiate_api__ArrayOfEmp2(struct soap*, int, const char*, const char*, size_t*);

inline struct api__ArrayOfEmp2 * soap_new_api__ArrayOfEmp2(struct soap *soap, int n = -1)
{
	return soap_instantiate_api__ArrayOfEmp2(soap, n, NULL, NULL, NULL);
}

inline struct api__ArrayOfEmp2 * soap_new_req_api__ArrayOfEmp2(
	struct soap *soap,
	const struct api__result& rslt)
{
	struct api__ArrayOfEmp2 *_p = ::soap_new_api__ArrayOfEmp2(soap);
	if (_p)
	{	::soap_default_api__ArrayOfEmp2(soap, _p);
		_p->rslt = rslt;
	}
	return _p;
}

inline struct api__ArrayOfEmp2 * soap_new_set_api__ArrayOfEmp2(
	struct soap *soap,
	const struct api__result& rslt)
{
	struct api__ArrayOfEmp2 *_p = ::soap_new_api__ArrayOfEmp2(soap);
	if (_p)
	{	::soap_default_api__ArrayOfEmp2(soap, _p);
		_p->rslt = rslt;
	}
	return _p;
}
SOAP_FMAC3 int SOAP_FMAC4 soap_put_api__ArrayOfEmp2(struct soap*, const struct api__ArrayOfEmp2 *, const char*, const char*);

inline int soap_write_api__ArrayOfEmp2(struct soap *soap, struct api__ArrayOfEmp2 const*p)
{
	soap_free_temp(soap);
	if (soap_begin_send(soap) || (::soap_serialize_api__ArrayOfEmp2(soap, p), 0) || ::soap_put_api__ArrayOfEmp2(soap, p, "api:ArrayOfEmp2", "") || soap_end_send(soap))
			return soap->error;
	return SOAP_OK;
}

inline int soap_PUT_api__ArrayOfEmp2(struct soap *soap, const char *URL, struct api__ArrayOfEmp2 const*p)
{
	soap_free_temp(soap);
	if (soap_PUT(soap, URL, NULL, "text/xml; charset=utf-8") || (::soap_serialize_api__ArrayOfEmp2(soap, p), 0) || ::soap_put_api__ArrayOfEmp2(soap, p, "api:ArrayOfEmp2", "") || soap_end_send(soap) || soap_recv_empty_response(soap))
		return soap_closesock(soap);
	return SOAP_OK;
}

inline int soap_PATCH_api__ArrayOfEmp2(struct soap *soap, const char *URL, struct api__ArrayOfEmp2 const*p)
{
	soap_free_temp(soap);
	if (soap_PATCH(soap, URL, NULL, "text/xml; charset=utf-8") || (::soap_serialize_api__ArrayOfEmp2(soap, p), 0) || ::soap_put_api__ArrayOfEmp2(soap, p, "api:ArrayOfEmp2", "") || soap_end_send(soap) || soap_recv_empty_response(soap))
		return soap_closesock(soap);
	return SOAP_OK;
}

inline int soap_POST_send_api__ArrayOfEmp2(struct soap *soap, const char *URL, struct api__ArrayOfEmp2 const*p)
{
	soap_free_temp(soap);
	if (soap_POST(soap, URL, NULL, "text/xml; charset=utf-8") || (::soap_serialize_api__ArrayOfEmp2(soap, p), 0) || ::soap_put_api__ArrayOfEmp2(soap, p, "api:ArrayOfEmp2", "") || soap_end_send(soap))
		return soap_closesock(soap);
	return SOAP_OK;
}
SOAP_FMAC3 struct api__ArrayOfEmp2 * SOAP_FMAC4 soap_get_api__ArrayOfEmp2(struct soap*, struct api__ArrayOfEmp2 *, const char*, const char*);

inline int soap_read_api__ArrayOfEmp2(struct soap *soap, struct api__ArrayOfEmp2 *p)
{
	if (p)
	{	::soap_default_api__ArrayOfEmp2(soap, p);
		if (soap_begin_recv(soap) || ::soap_get_api__ArrayOfEmp2(soap, p, NULL, NULL) == NULL || soap_end_recv(soap))
			return soap->error;
	}
	return SOAP_OK;
}

inline int soap_GET_api__ArrayOfEmp2(struct soap *soap, const char *URL, struct api__ArrayOfEmp2 *p)
{
	if (soap_GET(soap, URL, NULL) || ::soap_read_api__ArrayOfEmp2(soap, p))
		return soap_closesock(soap);
	return soap_closesock(soap);
}

inline int soap_POST_recv_api__ArrayOfEmp2(struct soap *soap, struct api__ArrayOfEmp2 *p)
{
	if (::soap_read_api__ArrayOfEmp2(soap, p))
		return soap_closesock(soap);
	return soap_closesock(soap);
}
#endif

#ifndef SOAP_TYPE_api__result_DEFINED
#define SOAP_TYPE_api__result_DEFINED
SOAP_FMAC3 void SOAP_FMAC4 soap_default_api__result(struct soap*, struct api__result *);
SOAP_FMAC3 void SOAP_FMAC4 soap_serialize_api__result(struct soap*, const struct api__result *);
SOAP_FMAC3 int SOAP_FMAC4 soap_out_api__result(struct soap*, const char*, int, const struct api__result *, const char*);
SOAP_FMAC3 struct api__result * SOAP_FMAC4 soap_in_api__result(struct soap*, const char*, struct api__result *, const char*);
SOAP_FMAC1 struct api__result * SOAP_FMAC2 soap_instantiate_api__result(struct soap*, int, const char*, const char*, size_t*);

inline struct api__result * soap_new_api__result(struct soap *soap, int n = -1)
{
	return soap_instantiate_api__result(soap, n, NULL, NULL, NULL);
}

inline struct api__result * soap_new_req_api__result(
	struct soap *soap,
	long flag,
	long idx,
	long age)
{
	struct api__result *_p = ::soap_new_api__result(soap);
	if (_p)
	{	::soap_default_api__result(soap, _p);
		_p->flag = flag;
		_p->idx = idx;
		_p->age = age;
	}
	return _p;
}

inline struct api__result * soap_new_set_api__result(
	struct soap *soap,
	long flag,
	long idx,
	long age,
	char *tell,
	char *email)
{
	struct api__result *_p = ::soap_new_api__result(soap);
	if (_p)
	{	::soap_default_api__result(soap, _p);
		_p->flag = flag;
		_p->idx = idx;
		_p->age = age;
		_p->tell = tell;
		_p->email = email;
	}
	return _p;
}
SOAP_FMAC3 int SOAP_FMAC4 soap_put_api__result(struct soap*, const struct api__result *, const char*, const char*);

inline int soap_write_api__result(struct soap *soap, struct api__result const*p)
{
	soap_free_temp(soap);
	if (soap_begin_send(soap) || (::soap_serialize_api__result(soap, p), 0) || ::soap_put_api__result(soap, p, "api:result", "") || soap_end_send(soap))
			return soap->error;
	return SOAP_OK;
}

inline int soap_PUT_api__result(struct soap *soap, const char *URL, struct api__result const*p)
{
	soap_free_temp(soap);
	if (soap_PUT(soap, URL, NULL, "text/xml; charset=utf-8") || (::soap_serialize_api__result(soap, p), 0) || ::soap_put_api__result(soap, p, "api:result", "") || soap_end_send(soap) || soap_recv_empty_response(soap))
		return soap_closesock(soap);
	return SOAP_OK;
}

inline int soap_PATCH_api__result(struct soap *soap, const char *URL, struct api__result const*p)
{
	soap_free_temp(soap);
	if (soap_PATCH(soap, URL, NULL, "text/xml; charset=utf-8") || (::soap_serialize_api__result(soap, p), 0) || ::soap_put_api__result(soap, p, "api:result", "") || soap_end_send(soap) || soap_recv_empty_response(soap))
		return soap_closesock(soap);
	return SOAP_OK;
}

inline int soap_POST_send_api__result(struct soap *soap, const char *URL, struct api__result const*p)
{
	soap_free_temp(soap);
	if (soap_POST(soap, URL, NULL, "text/xml; charset=utf-8") || (::soap_serialize_api__result(soap, p), 0) || ::soap_put_api__result(soap, p, "api:result", "") || soap_end_send(soap))
		return soap_closesock(soap);
	return SOAP_OK;
}
SOAP_FMAC3 struct api__result * SOAP_FMAC4 soap_get_api__result(struct soap*, struct api__result *, const char*, const char*);

inline int soap_read_api__result(struct soap *soap, struct api__result *p)
{
	if (p)
	{	::soap_default_api__result(soap, p);
		if (soap_begin_recv(soap) || ::soap_get_api__result(soap, p, NULL, NULL) == NULL || soap_end_recv(soap))
			return soap->error;
	}
	return SOAP_OK;
}

inline int soap_GET_api__result(struct soap *soap, const char *URL, struct api__result *p)
{
	if (soap_GET(soap, URL, NULL) || ::soap_read_api__result(soap, p))
		return soap_closesock(soap);
	return soap_closesock(soap);
}

inline int soap_POST_recv_api__result(struct soap *soap, struct api__result *p)
{
	if (::soap_read_api__result(soap, p))
		return soap_closesock(soap);
	return soap_closesock(soap);
}
#endif

#ifndef WITH_NOGLOBAL

#ifndef SOAP_TYPE_PointerToSOAP_ENV__Reason_DEFINED
#define SOAP_TYPE_PointerToSOAP_ENV__Reason_DEFINED
SOAP_FMAC3 void SOAP_FMAC4 soap_serialize_PointerToSOAP_ENV__Reason(struct soap*, struct SOAP_ENV__Reason *const*);
SOAP_FMAC3 int SOAP_FMAC4 soap_out_PointerToSOAP_ENV__Reason(struct soap*, const char *, int, struct SOAP_ENV__Reason *const*, const char *);
SOAP_FMAC3 struct SOAP_ENV__Reason ** SOAP_FMAC4 soap_in_PointerToSOAP_ENV__Reason(struct soap*, const char*, struct SOAP_ENV__Reason **, const char*);
SOAP_FMAC3 int SOAP_FMAC4 soap_put_PointerToSOAP_ENV__Reason(struct soap*, struct SOAP_ENV__Reason *const*, const char*, const char*);
SOAP_FMAC3 struct SOAP_ENV__Reason ** SOAP_FMAC4 soap_get_PointerToSOAP_ENV__Reason(struct soap*, struct SOAP_ENV__Reason **, const char*, const char*);
#endif

#endif

#ifndef WITH_NOGLOBAL

#ifndef SOAP_TYPE_PointerToSOAP_ENV__Detail_DEFINED
#define SOAP_TYPE_PointerToSOAP_ENV__Detail_DEFINED
SOAP_FMAC3 void SOAP_FMAC4 soap_serialize_PointerToSOAP_ENV__Detail(struct soap*, struct SOAP_ENV__Detail *const*);
SOAP_FMAC3 int SOAP_FMAC4 soap_out_PointerToSOAP_ENV__Detail(struct soap*, const char *, int, struct SOAP_ENV__Detail *const*, const char *);
SOAP_FMAC3 struct SOAP_ENV__Detail ** SOAP_FMAC4 soap_in_PointerToSOAP_ENV__Detail(struct soap*, const char*, struct SOAP_ENV__Detail **, const char*);
SOAP_FMAC3 int SOAP_FMAC4 soap_put_PointerToSOAP_ENV__Detail(struct soap*, struct SOAP_ENV__Detail *const*, const char*, const char*);
SOAP_FMAC3 struct SOAP_ENV__Detail ** SOAP_FMAC4 soap_get_PointerToSOAP_ENV__Detail(struct soap*, struct SOAP_ENV__Detail **, const char*, const char*);
#endif

#endif

#ifndef WITH_NOGLOBAL

#ifndef SOAP_TYPE_PointerToSOAP_ENV__Code_DEFINED
#define SOAP_TYPE_PointerToSOAP_ENV__Code_DEFINED
SOAP_FMAC3 void SOAP_FMAC4 soap_serialize_PointerToSOAP_ENV__Code(struct soap*, struct SOAP_ENV__Code *const*);
SOAP_FMAC3 int SOAP_FMAC4 soap_out_PointerToSOAP_ENV__Code(struct soap*, const char *, int, struct SOAP_ENV__Code *const*, const char *);
SOAP_FMAC3 struct SOAP_ENV__Code ** SOAP_FMAC4 soap_in_PointerToSOAP_ENV__Code(struct soap*, const char*, struct SOAP_ENV__Code **, const char*);
SOAP_FMAC3 int SOAP_FMAC4 soap_put_PointerToSOAP_ENV__Code(struct soap*, struct SOAP_ENV__Code *const*, const char*, const char*);
SOAP_FMAC3 struct SOAP_ENV__Code ** SOAP_FMAC4 soap_get_PointerToSOAP_ENV__Code(struct soap*, struct SOAP_ENV__Code **, const char*, const char*);
#endif

#endif

#ifndef SOAP_TYPE_PointerToxsd_string_DEFINED
#define SOAP_TYPE_PointerToxsd_string_DEFINED
SOAP_FMAC3 void SOAP_FMAC4 soap_serialize_PointerToxsd_string(struct soap*, char **const*);
SOAP_FMAC3 int SOAP_FMAC4 soap_out_PointerToxsd_string(struct soap*, const char *, int, char **const*, const char *);
SOAP_FMAC3 char *** SOAP_FMAC4 soap_in_PointerToxsd_string(struct soap*, const char*, char ***, const char*);
SOAP_FMAC3 int SOAP_FMAC4 soap_put_PointerToxsd_string(struct soap*, char **const*, const char*, const char*);
SOAP_FMAC3 char *** SOAP_FMAC4 soap_get_PointerToxsd_string(struct soap*, char ***, const char*, const char*);
#endif

#ifndef SOAP_TYPE_xsd_string_DEFINED
#define SOAP_TYPE_xsd_string_DEFINED

inline void soap_default_xsd_string(struct soap *soap, char **a)
{
	(void)soap; /* appease -Wall -Werror */
#ifdef SOAP_DEFAULT_xsd_string
	*a = SOAP_DEFAULT_xsd_string;
#else
	*a = (char *)0;
#endif
}
SOAP_FMAC3 void SOAP_FMAC4 soap_serialize_xsd_string(struct soap*, char *const*);

#define soap_xsd_string2s(soap, a) (a)
SOAP_FMAC3 int SOAP_FMAC4 soap_out_xsd_string(struct soap*, const char*, int, char*const*, const char*);

#define soap_s2xsd_string(soap, s, a) soap_s2char((soap), (s), (char**)(a), 1, 0, -1, NULL)
SOAP_FMAC3 char * * SOAP_FMAC4 soap_in_xsd_string(struct soap*, const char*, char **, const char*);

#define soap_instantiate_xsd_string soap_instantiate_string


#define soap_new_xsd_string soap_new_string

SOAP_FMAC3 int SOAP_FMAC4 soap_put_xsd_string(struct soap*, char *const*, const char*, const char*);

inline int soap_write_xsd_string(struct soap *soap, char *const*p)
{
	soap_free_temp(soap);
	if (p)
	{	if (soap_begin_send(soap) || ::soap_put_xsd_string(soap, p, "xsd-string", "") || soap_end_send(soap))
			return soap->error;
	}
	return SOAP_OK;
}

inline int soap_PUT_xsd_string(struct soap *soap, const char *URL, char *const*p)
{
	soap_free_temp(soap);
	if (soap_PUT(soap, URL, NULL, "text/xml; charset=utf-8") || ::soap_put_xsd_string(soap, p, "xsd-string", "") || soap_end_send(soap) || soap_recv_empty_response(soap))
		return soap_closesock(soap);
	return SOAP_OK;
}

inline int soap_PATCH_xsd_string(struct soap *soap, const char *URL, char *const*p)
{
	soap_free_temp(soap);
	if (soap_PATCH(soap, URL, NULL, "text/xml; charset=utf-8") || ::soap_put_xsd_string(soap, p, "xsd-string", "") || soap_end_send(soap) || soap_recv_empty_response(soap))
		return soap_closesock(soap);
	return SOAP_OK;
}

inline int soap_POST_send_xsd_string(struct soap *soap, const char *URL, char *const*p)
{
	soap_free_temp(soap);
	if (soap_POST(soap, URL, NULL, "text/xml; charset=utf-8") || ::soap_put_xsd_string(soap, p, "xsd-string", "") || soap_end_send(soap))
		return soap_closesock(soap);
	return SOAP_OK;
}
SOAP_FMAC3 char ** SOAP_FMAC4 soap_get_xsd_string(struct soap*, char **, const char*, const char*);

inline int soap_read_xsd_string(struct soap *soap, char **p)
{
	if (p)
	{	if (soap_begin_recv(soap) || ::soap_get_xsd_string(soap, p, NULL, NULL) == NULL || soap_end_recv(soap))
			return soap->error;
	}
	return SOAP_OK;
}

inline int soap_GET_xsd_string(struct soap *soap, const char *URL, char **p)
{
	if (soap_GET(soap, URL, NULL) || ::soap_read_xsd_string(soap, p))
		return soap_closesock(soap);
	return soap_closesock(soap);
}

inline int soap_POST_recv_xsd_string(struct soap *soap, char **p)
{
	if (::soap_read_xsd_string(soap, p))
		return soap_closesock(soap);
	return soap_closesock(soap);
}
#endif

#ifndef SOAP_TYPE__QName_DEFINED
#define SOAP_TYPE__QName_DEFINED

inline void soap_default__QName(struct soap *soap, char **a)
{
	(void)soap; /* appease -Wall -Werror */
#ifdef SOAP_DEFAULT__QName
	*a = SOAP_DEFAULT__QName;
#else
	*a = (char *)0;
#endif
}
SOAP_FMAC3 void SOAP_FMAC4 soap_serialize__QName(struct soap*, char *const*);

#define soap__QName2s(soap, a) soap_QName2s(soap, (a))
SOAP_FMAC3 int SOAP_FMAC4 soap_out__QName(struct soap*, const char*, int, char*const*, const char*);

#define soap_s2_QName(soap, s, a) soap_s2QName((soap), (s), (char**)(a), 0, -1, NULL)
SOAP_FMAC3 char * * SOAP_FMAC4 soap_in__QName(struct soap*, const char*, char **, const char*);

#define soap_instantiate__QName soap_instantiate_string


#define soap_new__QName soap_new_string

SOAP_FMAC3 int SOAP_FMAC4 soap_put__QName(struct soap*, char *const*, const char*, const char*);

inline int soap_write__QName(struct soap *soap, char *const*p)
{
	soap_free_temp(soap);
	if (p)
	{	if (soap_begin_send(soap) || ::soap_put__QName(soap, p, "QName", "") || soap_end_send(soap))
			return soap->error;
	}
	return SOAP_OK;
}

inline int soap_PUT__QName(struct soap *soap, const char *URL, char *const*p)
{
	soap_free_temp(soap);
	if (soap_PUT(soap, URL, NULL, "text/xml; charset=utf-8") || ::soap_put__QName(soap, p, "QName", "") || soap_end_send(soap) || soap_recv_empty_response(soap))
		return soap_closesock(soap);
	return SOAP_OK;
}

inline int soap_PATCH__QName(struct soap *soap, const char *URL, char *const*p)
{
	soap_free_temp(soap);
	if (soap_PATCH(soap, URL, NULL, "text/xml; charset=utf-8") || ::soap_put__QName(soap, p, "QName", "") || soap_end_send(soap) || soap_recv_empty_response(soap))
		return soap_closesock(soap);
	return SOAP_OK;
}

inline int soap_POST_send__QName(struct soap *soap, const char *URL, char *const*p)
{
	soap_free_temp(soap);
	if (soap_POST(soap, URL, NULL, "text/xml; charset=utf-8") || ::soap_put__QName(soap, p, "QName", "") || soap_end_send(soap))
		return soap_closesock(soap);
	return SOAP_OK;
}
SOAP_FMAC3 char ** SOAP_FMAC4 soap_get__QName(struct soap*, char **, const char*, const char*);

inline int soap_read__QName(struct soap *soap, char **p)
{
	if (p)
	{	if (soap_begin_recv(soap) || ::soap_get__QName(soap, p, NULL, NULL) == NULL || soap_end_recv(soap))
			return soap->error;
	}
	return SOAP_OK;
}

inline int soap_GET__QName(struct soap *soap, const char *URL, char **p)
{
	if (soap_GET(soap, URL, NULL) || ::soap_read__QName(soap, p))
		return soap_closesock(soap);
	return soap_closesock(soap);
}

inline int soap_POST_recv__QName(struct soap *soap, char **p)
{
	if (::soap_read__QName(soap, p))
		return soap_closesock(soap);
	return soap_closesock(soap);
}
#endif

#ifndef SOAP_TYPE__XML_DEFINED
#define SOAP_TYPE__XML_DEFINED
#endif

#ifndef SOAP_TYPE_string_DEFINED
#define SOAP_TYPE_string_DEFINED

inline void soap_default_string(struct soap *soap, char **a)
{
	(void)soap; /* appease -Wall -Werror */
#ifdef SOAP_DEFAULT_string
	*a = SOAP_DEFAULT_string;
#else
	*a = (char *)0;
#endif
}
SOAP_FMAC3 void SOAP_FMAC4 soap_serialize_string(struct soap*, char *const*);

#define soap_string2s(soap, a) (a)
SOAP_FMAC3 int SOAP_FMAC4 soap_out_string(struct soap*, const char*, int, char*const*, const char*);

#define soap_s2string(soap, s, a) soap_s2char((soap), (s), (char**)(a), 1, 0, -1, NULL)
SOAP_FMAC3 char * * SOAP_FMAC4 soap_in_string(struct soap*, const char*, char **, const char*);

SOAP_FMAC3 char * * SOAP_FMAC4 soap_new_string(struct soap *soap, int n = -1);
SOAP_FMAC3 int SOAP_FMAC4 soap_put_string(struct soap*, char *const*, const char*, const char*);

inline int soap_write_string(struct soap *soap, char *const*p)
{
	soap_free_temp(soap);
	if (p)
	{	if (soap_begin_send(soap) || ::soap_put_string(soap, p, "string", "") || soap_end_send(soap))
			return soap->error;
	}
	return SOAP_OK;
}

inline int soap_PUT_string(struct soap *soap, const char *URL, char *const*p)
{
	soap_free_temp(soap);
	if (soap_PUT(soap, URL, NULL, "text/xml; charset=utf-8") || ::soap_put_string(soap, p, "string", "") || soap_end_send(soap) || soap_recv_empty_response(soap))
		return soap_closesock(soap);
	return SOAP_OK;
}

inline int soap_PATCH_string(struct soap *soap, const char *URL, char *const*p)
{
	soap_free_temp(soap);
	if (soap_PATCH(soap, URL, NULL, "text/xml; charset=utf-8") || ::soap_put_string(soap, p, "string", "") || soap_end_send(soap) || soap_recv_empty_response(soap))
		return soap_closesock(soap);
	return SOAP_OK;
}

inline int soap_POST_send_string(struct soap *soap, const char *URL, char *const*p)
{
	soap_free_temp(soap);
	if (soap_POST(soap, URL, NULL, "text/xml; charset=utf-8") || ::soap_put_string(soap, p, "string", "") || soap_end_send(soap))
		return soap_closesock(soap);
	return SOAP_OK;
}
SOAP_FMAC3 char ** SOAP_FMAC4 soap_get_string(struct soap*, char **, const char*, const char*);

inline int soap_read_string(struct soap *soap, char **p)
{
	if (p)
	{	if (soap_begin_recv(soap) || ::soap_get_string(soap, p, NULL, NULL) == NULL || soap_end_recv(soap))
			return soap->error;
	}
	return SOAP_OK;
}

inline int soap_GET_string(struct soap *soap, const char *URL, char **p)
{
	if (soap_GET(soap, URL, NULL) || ::soap_read_string(soap, p))
		return soap_closesock(soap);
	return soap_closesock(soap);
}

inline int soap_POST_recv_string(struct soap *soap, char **p)
{
	if (::soap_read_string(soap, p))
		return soap_closesock(soap);
	return soap_closesock(soap);
}
#endif

#endif

/* End of soapH.h */
